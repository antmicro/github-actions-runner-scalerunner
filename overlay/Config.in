## overlay/Config.in
```kconfig
source "$BR2_EXTERNAL_GHA_SCALENODE_OVERLAY_PATH/package/node-sif/Config.in"
source "$BR2_EXTERNAL_GHA_SCALENODE_OVERLAY_PATH/package/utility-sif/Config.in"
```

## overlay/configs/scalenode_gcp_arm64_defconfig
```kconfig
BR2_aarch64=y
BR2_neoverse_n1=y
BR2_CCACHE=y
BR2_PER_PACKAGE_DIRECTORIES=y
BR2_TOOLCHAIN_BUILDROOT_GLIBC=y
BR2_TOOLCHAIN_BUILDROOT_CXX=y
BR2_GCC_ENABLE_LTO=y
BR2_GCC_ENABLE_OPENMP=y
BR2_TARGET_GENERIC_HOSTNAME="scalerunner"
BR2_TARGET_GENERIC_ISSUE="Welcome to Scalerunner OS"
BR2_ROOTFS_DEVICE_CREATION_DYNAMIC_EUDEV=y
BR2_TARGET_GENERIC_ROOT_PASSWD="root"
BR2_SYSTEM_BIN_SH_BASH=y
BR2_TARGET_TZ_INFO=y
BR2_TARGET_LOCALTIME="Europe/Paris"
BR2_ROOTFS_USERS_TABLES="$(BR2_EXTERNAL_GHA_SCALENODE_OVERLAY_PATH)/board/scalenode_gcp/users_table"
BR2_ROOTFS_OVERLAY="$(BR2_EXTERNAL_GHA_SCALENODE_OVERLAY_PATH)/board/scalenode_gcp/rootfs_overlay"
BR2_LINUX_KERNEL=y
BR2_LINUX_KERNEL_USE_CUSTOM_CONFIG=y
BR2_LINUX_KERNEL_CUSTOM_CONFIG_FILE="$(BR2_EXTERNAL_GHA_SCALENODE_OVERLAY_PATH)/board/scalenode_gcp/linux-arm64.config"
BR2_LINUX_KERNEL_NEEDS_HOST_OPENSSL=y
BR2_PACKAGE_BUSYBOX_SHOW_OTHERS=y
BR2_PACKAGE_BUSYBOX_CONFIG_FRAGMENT_FILES="$(BR2_EXTERNAL_GHA_SCALENODE_OVERLAY_PATH)/board/scalenode_gcp/busybox.config"
BR2_PACKAGE_KEXEC=y
BR2_PACKAGE_GIT=y
BR2_PACKAGE_GZIP=y
BR2_PACKAGE_LIBTOOL=y
BR2_PACKAGE_SQUASHFS=y
BR2_PACKAGE_LIBERATION=y
BR2_PACKAGE_LINUX_FIRMWARE=y
BR2_PACKAGE_ACPID=y
BR2_PACKAGE_DMIDECODE=y
BR2_PACKAGE_LM_SENSORS=y
BR2_PACKAGE_LM_SENSORS_FANCONTROL=y
BR2_PACKAGE_LM_SENSORS_PWMCONFIG=y
BR2_PACKAGE_NVME=y
BR2_PACKAGE_PCIUTILS=y
BR2_PACKAGE_SYSSTAT=y
BR2_PACKAGE_USBUTILS=y
BR2_PACKAGE_PYTHON_PARAMIKO=y
BR2_PACKAGE_PYTHON_PIP=y
BR2_PACKAGE_PYTHON_PYASN1=y
BR2_PACKAGE_PYTHON_REQUESTS=y
BR2_PACKAGE_LZO=y
BR2_PACKAGE_CA_CERTIFICATES=y
BR2_PACKAGE_CAIRO=y
BR2_PACKAGE_CAIRO_PNG=y
BR2_PACKAGE_IMLIB2=y
BR2_PACKAGE_IMLIB2_JPEG=y
BR2_PACKAGE_IMLIB2_PNG=y
BR2_PACKAGE_DTC=y
BR2_PACKAGE_LIBPCIACCESS=y
BR2_PACKAGE_MTDEV=y
BR2_PACKAGE_LIBCURL=y
BR2_PACKAGE_LIBCURL_CURL=y
BR2_PACKAGE_LIBCAP=y
BR2_PACKAGE_LIBEVDEV=y
BR2_PACKAGE_LIBGLIB2=y
BR2_PACKAGE_LIBPTHREAD_STUBS=y
BR2_PACKAGE_LIBSECCOMP=y
BR2_PACKAGE_LINUX_PAM=y
BR2_PACKAGE_XUTIL_UTIL_MACROS=y
BR2_PACKAGE_DHCPCD=y
BR2_PACKAGE_IPTABLES=y
BR2_PACKAGE_NETSNMP=y
BR2_PACKAGE_NTP=y
BR2_PACKAGE_OPENSSH=y
BR2_PACKAGE_RSYNC=y
BR2_PACKAGE_SOCAT=y
BR2_PACKAGE_FILE=y
BR2_PACKAGE_SARGRAPH=y
BR2_PACKAGE_SUDO=y
BR2_PACKAGE_TMUX=y
BR2_PACKAGE_APPTAINER=y
BR2_PACKAGE_APPTAINER_SINGULARITY_SYMLINK=y
BR2_PACKAGE_CGROUPFS_MOUNT=y
BR2_PACKAGE_IOTOP=y
BR2_PACKAGE_UTIL_LINUX_BINARIES=y
BR2_PACKAGE_UTIL_LINUX_MOUNT=y
BR2_PACKAGE_UTIL_LINUX_MOUNTPOINT=y
BR2_PACKAGE_UTIL_LINUX_PIVOT_ROOT=y
BR2_PACKAGE_VIM=y
BR2_TARGET_ROOTFS_INITRAMFS=y
# BR2_TARGET_ROOTFS_TAR is not set
BR2_PACKAGE_HOST_DOSFSTOOLS=y
BR2_PACKAGE_HOST_MTOOLS=y
BR2_PACKAGE_NODE_SIF=y
BR2_PACKAGE_UTILITY_SIF=y
BR2_PACKAGE_GCP_GUEST_CONFIGS=y
BR2_PACKAGE_JQ=y
```

## overlay/configs/scalenode_gcp_defconfig
```kconfig
BR2_x86_64=y
BR2_CCACHE=y
BR2_PER_PACKAGE_DIRECTORIES=y
BR2_TOOLCHAIN_BUILDROOT_GLIBC=y
BR2_PACKAGE_HOST_LINUX_HEADERS_CUSTOM_5_7=y
BR2_TOOLCHAIN_BUILDROOT_CXX=y
BR2_GCC_ENABLE_OPENMP=y
BR2_ROOTFS_DEVICE_CREATION_DYNAMIC_EUDEV=y
BR2_TARGET_GENERIC_ROOT_PASSWD="root"
BR2_SYSTEM_BIN_SH_BASH=y
BR2_TARGET_TZ_INFO=y
BR2_TARGET_LOCALTIME="Europe/Paris"
BR2_ROOTFS_USERS_TABLES="$(BR2_EXTERNAL_GHA_SCALENODE_OVERLAY)/board/scalenode_gcp/users_table"
BR2_ROOTFS_OVERLAY="$(BR2_EXTERNAL_GHA_SCALENODE_OVERLAY)/board/scalenode_gcp/rootfs_overlay"
BR2_LINUX_KERNEL=y
BR2_LINUX_KERNEL_USE_CUSTOM_CONFIG=y
BR2_LINUX_KERNEL_CUSTOM_CONFIG_FILE="$(BR2_EXTERNAL_GHA_SCALENODE_OVERLAY)/board/scalenode_gcp/linux.config"
BR2_LINUX_KERNEL_NEEDS_HOST_OPENSSL=y
BR2_PACKAGE_BUSYBOX_SHOW_OTHERS=y
BR2_PACKAGE_ALSA_UTILS=y
BR2_PACKAGE_PULSEAUDIO=y
BR2_PACKAGE_PULSEAUDIO_DAEMON=y
BR2_PACKAGE_KEXEC=y
BR2_PACKAGE_GIT=y
BR2_PACKAGE_SQUASHFS=y
BR2_PACKAGE_GNUPLOT=y
BR2_PACKAGE_MESA3D_DEMOS=y
BR2_PACKAGE_MESA3D=y
BR2_PACKAGE_MESA3D_GALLIUM_DRIVER_VIRGL=y
BR2_PACKAGE_MESA3D_DRI_DRIVER_SWRAST=y
BR2_PACKAGE_MESA3D_DRI_DRIVER_I915=y
BR2_PACKAGE_MESA3D_DRI_DRIVER_I965=y
BR2_PACKAGE_MESA3D_VULKAN_DRIVER_INTEL=y
BR2_PACKAGE_MESA3D_OPENGL_GLX=y
BR2_PACKAGE_MESA3D_OPENGL_ES=y
BR2_PACKAGE_WESTON=y
BR2_PACKAGE_WESTON_DRM=y
BR2_PACKAGE_WESTON_X11=y
BR2_PACKAGE_WESTON_XWAYLAND=y
BR2_PACKAGE_XORG7=y
BR2_PACKAGE_XSERVER_XORG_SERVER=y
BR2_PACKAGE_XAPP_SETXKBMAP=y
BR2_PACKAGE_XAPP_XCLOCK=y
BR2_PACKAGE_XAPP_XCOMPMGR=y
BR2_PACKAGE_XAPP_XHOST=y
BR2_PACKAGE_XAPP_XINIT=y
BR2_PACKAGE_XAPP_XINPUT=y
BR2_PACKAGE_XAPP_XKILL=y
BR2_PACKAGE_XAPP_XRANDR=y
BR2_PACKAGE_XAPP_XRDB=y
BR2_PACKAGE_XAPP_XSET=y
BR2_PACKAGE_XAPP_XSETROOT=y
BR2_PACKAGE_XDRIVER_XF86_INPUT_EVDEV=y
BR2_PACKAGE_XDRIVER_XF86_INPUT_KEYBOARD=y
BR2_PACKAGE_XDRIVER_XF86_INPUT_LIBINPUT=y
BR2_PACKAGE_XDRIVER_XF86_INPUT_MOUSE=y
BR2_PACKAGE_XDRIVER_XF86_INPUT_SYNAPTICS=y
BR2_PACKAGE_XDRIVER_XF86_VIDEO_FBDEV=y
BR2_PACKAGE_XDRIVER_XF86_VIDEO_INTEL=y
BR2_PACKAGE_XDRIVER_XF86_VIDEO_VESA=y
BR2_PACKAGE_FEH=y
BR2_PACKAGE_X11VNC=y
BR2_PACKAGE_XDOTOOL=y
BR2_PACKAGE_XTERM=y
BR2_PACKAGE_RATPOISON=y
BR2_PACKAGE_LINUX_FIRMWARE=y
BR2_PACKAGE_ACPID=y
BR2_PACKAGE_DMIDECODE=y
BR2_PACKAGE_LM_SENSORS=y
BR2_PACKAGE_LM_SENSORS_FANCONTROL=y
BR2_PACKAGE_LM_SENSORS_ISADUMP=y
BR2_PACKAGE_LM_SENSORS_ISASET=y
BR2_PACKAGE_LM_SENSORS_PWMCONFIG=y
BR2_PACKAGE_PCIUTILS=y
BR2_PACKAGE_SYSSTAT=y
BR2_PACKAGE_USBUTILS=y
BR2_PACKAGE_PYTHON3=y
BR2_PACKAGE_PYTHON_PARAMIKO=y
BR2_PACKAGE_PYTHON_PIP=y
BR2_PACKAGE_PYTHON_PYASN1=y
BR2_PACKAGE_PYTHON_REQUESTS=y
BR2_PACKAGE_CA_CERTIFICATES=y
BR2_PACKAGE_LIBEPOXY=y
BR2_PACKAGE_WAFFLE=y
BR2_PACKAGE_LIBCURL=y
BR2_PACKAGE_LIBCURL_CURL=y
BR2_PACKAGE_LIBCAP=y
BR2_PACKAGE_LIBSECCOMP=y
BR2_PACKAGE_LINUX_PAM=y
BR2_PACKAGE_QEMU=y
BR2_PACKAGE_QEMU_CUSTOM_TARGETS="x86_64-softmmu"
BR2_PACKAGE_QEMU_SLIRP=y
BR2_PACKAGE_QEMU_FDT=y
BR2_PACKAGE_QEMU_TOOLS=y
BR2_PACKAGE_DHCPCD=y
BR2_PACKAGE_IPTABLES=y
BR2_PACKAGE_NETSNMP=y
BR2_PACKAGE_NTP=y
BR2_PACKAGE_OPENSSH=y
BR2_PACKAGE_RSYNC=y
BR2_PACKAGE_SOCAT=y
BR2_PACKAGE_FILE=y
BR2_PACKAGE_SCREEN=y
BR2_PACKAGE_SUDO=y
BR2_PACKAGE_TMUX=y
BR2_PACKAGE_CGROUPFS_MOUNT=y
BR2_PACKAGE_DOCKER_CONTAINERD=y
BR2_PACKAGE_HTOP=y
BR2_PACKAGE_IOTOP=y
BR2_PACKAGE_SINGULARITY=y
BR2_PACKAGE_VIM=y
BR2_TARGET_ROOTFS_INITRAMFS=y
# BR2_TARGET_ROOTFS_TAR is not set
BR2_PACKAGE_HOST_DOSFSTOOLS=y
BR2_PACKAGE_HOST_MTOOLS=y
```

## overlay/package/gcp-guest-configs/Config.in
```kconfig
config BR2_PACKAGE_GCP_GUEST_CONFIGS
	bool "gcp-guest-configs"
	depends on BR2_x86_64 || BR2_aarch64
```

## overlay/package/node-sif/Config.in
```kconfig
config BR2_PACKAGE_NODE_SIF
	bool "node-sif"
	depends on BR2_x86_64 || BR2_aarch64
	help
	  Node 16 packaged as a SIF image.
```

## overlay/package/utility-sif/Config.in
```kconfig
config BR2_PACKAGE_UTILITY_SIF
	bool "utility-sif"
	help
	  GHA Runners Utility container
```
